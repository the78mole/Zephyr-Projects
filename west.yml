## west.yml
```yaml
manifest:
  projects:
    - name: zephyr
      url: https://github.com/zephyrproject-rtos/zephyr
      revision: v3.7.0
      import: true

  self:
    path: ESP32-Zephyr-Test  # wird bei 'west init -l .' korrekt aufgelöst
```
