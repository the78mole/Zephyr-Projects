## CMakeLists.txt
```
# SPDX-License-Identifier: Apache-2.0

cmake_minimum_required(VERSION 3.20.0)

# Add BTHome module to the module path before finding Zephyr
list(APPEND ZEPHYR_EXTRA_MODULES
    ${CMAKE_CURRENT_SOURCE_DIR}/../../lib/bthome
)

find_package(Zephyr REQUIRED HINTS $ENV{ZEPHYR_BASE})
project(bthome_counter)

# BTHome module is now automatically loaded via CONFIG_BTHOME=y

target_sources(app PRIVATE src/main.c)
```

## prj.conf
```kconfig
# Bluetooth Low Energy Configuration
CONFIG_BT=y
CONFIG_BT_PERIPHERAL=y
CONFIG_BT_DEVICE_NAME="BTHome Counter"

# BTHome v2 Module Configuration
CONFIG_BTHOME=y
CONFIG_BTHOME_AUTO_MAC=y
CONFIG_BTHOME_DEVICE_NAME_MAX_LEN=20
CONFIG_BTHOME_MAX_MEASUREMENTS=5

# BTHome requires specific advertisement settings
CONFIG_BT_BROADCASTER=y
CONFIG_BT_EXT_ADV=n

# Bluetooth identity configuration
CONFIG_BT_PRIVACY=n
CONFIG_BT_SETTINGS=n
CONFIG_BT_ID_MAX=1

# Stelle sicher, dass Extended Advertising wirklich aus ist
CONFIG_BT_CTLR_ADV_EXT=n

# Allow connections (minimum 1 required by Zephyr)
CONFIG_BT_MAX_CONN=1

# GPIO for LED control
CONFIG_GPIO=y

# Logging configuration
CONFIG_LOG=y
CONFIG_LOG_DEFAULT_LEVEL=3
CONFIG_PRINTK=y
CONFIG_CONSOLE=y

# System configuration
CONFIG_MAIN_STACK_SIZE=2048
CONFIG_SYSTEM_WORKQUEUE_STACK_SIZE=2048

# Memory optimization for BTHome
CONFIG_BT_CTLR_RX_BUFFERS=1
```

## src/main.c
```c
/*
 * Copyright (c) 2025 BTHome Counter Example with Library
 *
 * SPDX-License-Identifier: Apache-2.0
 */

#include <zephyr/kernel.h>
#include <bthome.h>
#include <zephyr/bluetooth/bluetooth.h>
#include <zephyr/drivers/gpio.h>
#include <zephyr/logging/log.h>

LOG_MODULE_REGISTER(bthome_counter, LOG_LEVEL_INF);

/* LED for visual feedback */
#define LED1_NODE DT_ALIAS(led0)
static const struct gpio_dt_spec led1 = GPIO_DT_SPEC_GET(LED1_NODE, gpios);

/* BTHome device instance */
static struct bthome_device bthome_dev;

/* Counter state */
static uint16_t counter_value = 0;

/* Bluetooth ready callback */
static void bt_ready(int err)
{
    if (err) {
        LOG_ERR("Bluetooth init failed (err %d)", err);
        return;
    }

    LOG_INF("Bluetooth initialized");
}

/* Work handler for periodic counter updates */
static void counter_work_handler(struct k_work *work);
static K_WORK_DELAYABLE_DEFINE(counter_work, counter_work_handler);

static void counter_work_handler(struct k_work *work)
{
    int err;

    /* LED on - advertisement cycle starts */
    gpio_pin_set_dt(&led1, 1);

    /* Reset measurements for new packet */
    bthome_reset_measurements(&bthome_dev);

    /* Increment counter */
    counter_value++;

    /* Add counter measurement (16-bit) */
    err = bthome_add_sensor(&bthome_dev, BTHOME_ID_COUNT2, counter_value);
    if (err) {
        LOG_ERR("Failed to add counter: %d", err);
        goto cleanup;
    }

    /* Send advertisement */
    err = bthome_advertise(&bthome_dev, 1500);  /* Advertise for 1.5 seconds */
    if (err) {
        LOG_ERR("Failed to start advertising: %d", err);
        goto cleanup;
    }

    LOG_INF("BTHome advertisement sent: Counter = %u", counter_value);

cleanup:
    /* LED off after short delay */
    k_sleep(K_MSEC(100));
    gpio_pin_set_dt(&led1, 0);

    /* Schedule next advertisement in 5 seconds */
    k_work_schedule(&counter_work, K_SECONDS(5));
}

int main(void)
{
    int err;
    struct bthome_config config = {
        .device_name = "BTHome Counter",
        .encryption = false,
        .trigger_based = false,
    };

    LOG_INF("BTHome Counter Example for nRF52840-DK (with Library)");
    LOG_INF("Board: %s", CONFIG_BOARD_TARGET);

    /* Initialize LED */
    if (!gpio_is_ready_dt(&led1)) {
        LOG_ERR("LED1 device not ready");
        return -1;
    }
    
    err = gpio_pin_configure_dt(&led1, GPIO_OUTPUT_INACTIVE);
    if (err < 0) {
        LOG_ERR("Failed to configure LED1: %d", err);
        return -1;
    }

    LOG_INF("LED1 initialized successfully");

    /* Set fixed MAC address manually */
    err = bthome_set_fixed_mac();
    if (err) {
        LOG_WRN("Failed to set fixed MAC: %d", err);
    }

    /* Initialize BTHome device */
    err = bthome_init(&bthome_dev, &config);
    if (err) {
        LOG_ERR("Failed to initialize BTHome device: %d", err);
        return -1;
    }

    /* Initialize Bluetooth */
    err = bt_enable(bt_ready);
    if (err) {
        LOG_ERR("Bluetooth init failed (err %d)", err);
        return -1;
    }

    /* Wait for Bluetooth to be ready */
    k_sleep(K_SECONDS(2));

    /* Start periodic counter updates */
    k_work_schedule(&counter_work, K_SECONDS(3));

    LOG_INF("BTHome Counter is running...");
    LOG_INF("Sending counter values every 5 seconds");
    LOG_INF("Use nRF Connect or Home Assistant to receive BTHome data");

    /* Main loop */
    while (1) {
        k_sleep(K_SECONDS(10));
        LOG_INF("System running, current counter: %u", counter_value);
    }

    return 0;
}
```
